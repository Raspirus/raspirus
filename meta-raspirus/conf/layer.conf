## meta-raspirus/conf/layer.conf
```bitbake
BBPATH .= ":${LAYERDIR}"

BBFILES += "${LAYERDIR}/recipes-*/*/*.bb"
BBFILE_COLLECTIONS += "raspirus"
BBFILE_PATTERN_raspirus = "^${LAYERDIR}/"
BBFILE_PRIORITY_raspirus = "6"

LAYERVERSION_raspirus = "1"
```

## meta-raspirus/conf/local.conf
```bitbake
# Set the machine/architecture for the build
MACHINE ??= "qemuarm"

# Set the number of parallel tasks for the build
BB_NUMBER_THREADS = "4"
PARALLEL_MAKE = "-j 4"

# Enable debugging information
DEBUG_BUILD = "1"

# Set the download directory
DL_DIR = "${TOPDIR}/downloads"

# Set the build directory
SSTATE_DIR = "${TOPDIR}/sstate-cache"
BUILD_DIR = "${TOPDIR}/build"

# Enable or disable BitBake's logging
BBDEBUG = "1"
```
